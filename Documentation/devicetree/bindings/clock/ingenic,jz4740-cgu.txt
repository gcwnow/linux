## arch/mips/configs/a320_defconfig
```kconfig
CONFIG_MACH_INGENIC=y
CONFIG_JZ4740_A320=y
# CONFIG_COMPACTION is not set
CONFIG_CLEANCACHE=y
CONFIG_FRONTSWAP=y
CONFIG_ZSMALLOC=y
CONFIG_PREEMPT_VOLUNTARY=y
# CONFIG_SECCOMP is not set
CONFIG_LOCALVERSION="-dingux"
CONFIG_DEFAULT_HOSTNAME="opendingux"
CONFIG_SYSVIPC=y
# CONFIG_CROSS_MEMORY_ATTACH is not set
# CONFIG_FHANDLE is not set
CONFIG_NO_HZ=y
CONFIG_LOG_BUF_SHIFT=14
CONFIG_SYSCTL_SYSCALL=y
# CONFIG_KALLSYMS is not set
# CONFIG_ELF_CORE is not set
# CONFIG_BASE_FULL is not set
CONFIG_EMBEDDED=y
# CONFIG_VM_EVENT_COUNTERS is not set
CONFIG_SLAB=y
# CONFIG_LBDAF is not set
# CONFIG_BLK_DEV_BSG is not set
# CONFIG_IOSCHED_CFQ is not set
CONFIG_NET=y
CONFIG_PACKET=y
CONFIG_UNIX=y
CONFIG_INET=y
# CONFIG_INET_XFRM_MODE_TRANSPORT is not set
# CONFIG_INET_XFRM_MODE_TUNNEL is not set
# CONFIG_INET_XFRM_MODE_BEET is not set
# CONFIG_INET_DIAG is not set
# CONFIG_IPV6 is not set
# CONFIG_WIRELESS is not set
CONFIG_UEVENT_HELPER_PATH="/sbin/hotplug"
CONFIG_DEVTMPFS=y
CONFIG_DEVTMPFS_MOUNT=y
# CONFIG_FW_LOADER is not set
CONFIG_MTD=y
CONFIG_MTD_NAND=y
CONFIG_MTD_UBI=y
CONFIG_ZRAM=y
CONFIG_BLK_DEV_LOOP=y
CONFIG_BLK_DEV_LOOP_MIN_COUNT=0
CONFIG_NETDEVICES=y
# CONFIG_WLAN is not set
# CONFIG_INPUT_MOUSEDEV_PSAUX is not set
CONFIG_INPUT_MOUSEDEV_SCREEN_X=320
CONFIG_INPUT_MOUSEDEV_SCREEN_Y=240
CONFIG_INPUT_EVDEV=y
# CONFIG_KEYBOARD_ATKBD is not set
CONFIG_KEYBOARD_GPIO=y
# CONFIG_INPUT_MOUSE is not set
CONFIG_INPUT_MISC=y
CONFIG_INPUT_UINPUT=y
# CONFIG_SERIO is not set
CONFIG_VT_HW_CONSOLE_BINDING=y
CONFIG_LEGACY_PTY_COUNT=2
# CONFIG_DEVMEM is not set
# CONFIG_DEVKMEM is not set
CONFIG_SERIAL_8250=y
# CONFIG_SERIAL_8250_DEPRECATED_OPTIONS is not set
CONFIG_SERIAL_8250_CONSOLE=y
CONFIG_SERIAL_8250_NR_UARTS=2
CONFIG_SERIAL_8250_RUNTIME_UARTS=2
CONFIG_SERIAL_8250_INGENIC=y
# CONFIG_HW_RANDOM is not set
CONFIG_I2C=y
# CONFIG_I2C_COMPAT is not set
CONFIG_I2C_CHARDEV=y
CONFIG_POWER_SUPPLY=y
# CONFIG_HWMON is not set
CONFIG_WATCHDOG=y
CONFIG_JZ4740_WDT=y
CONFIG_REGULATOR=y
CONFIG_REGULATOR_FIXED_VOLTAGE=y
CONFIG_MEDIA_SUPPORT=y
CONFIG_MEDIA_RADIO_SUPPORT=y
# CONFIG_MEDIA_TUNER_SIMPLE is not set
# CONFIG_MEDIA_TUNER_TDA8290 is not set
# CONFIG_MEDIA_TUNER_TDA827X is not set
# CONFIG_MEDIA_TUNER_TDA18271 is not set
# CONFIG_MEDIA_TUNER_TDA9887 is not set
# CONFIG_MEDIA_TUNER_TEA5761 is not set
# CONFIG_MEDIA_TUNER_TEA5767 is not set
# CONFIG_MEDIA_TUNER_MT20XX is not set
# CONFIG_MEDIA_TUNER_MT2060 is not set
# CONFIG_MEDIA_TUNER_MT2266 is not set
# CONFIG_MEDIA_TUNER_MT2131 is not set
# CONFIG_MEDIA_TUNER_QT1010 is not set
# CONFIG_MEDIA_TUNER_XC2028 is not set
# CONFIG_MEDIA_TUNER_XC5000 is not set
# CONFIG_MEDIA_TUNER_MXL5005S is not set
# CONFIG_MEDIA_TUNER_MXL5007T is not set
# CONFIG_MEDIA_TUNER_MC44S803 is not set
# CONFIG_MEDIA_TUNER_MAX2165 is not set
# CONFIG_MEDIA_TUNER_TDA18218 is not set
# CONFIG_MEDIA_TUNER_TDA18212 is not set
CONFIG_FB=y
# CONFIG_VGA_CONSOLE is not set
CONFIG_SOUND=y
CONFIG_SND=y
# CONFIG_SND_SUPPORT_OLD_API is not set
# CONFIG_SND_VERBOSE_PROCFS is not set
# CONFIG_SND_DRIVERS is not set
# CONFIG_SND_MIPS is not set
CONFIG_SND_SOC=y
CONFIG_USB_GADGET=y
CONFIG_USB_GADGET_VBUS_DRAW=500
CONFIG_USB_ETH=y
CONFIG_MMC=y
# CONFIG_MMC_BLOCK_BOUNCE is not set
CONFIG_RTC_CLASS=y
CONFIG_RTC_DRV_JZ4740=y
CONFIG_DMADEVICES=y
CONFIG_STAGING=y
# CONFIG_MIPS_PLATFORM_DEVICES is not set
# CONFIG_IOMMU_SUPPORT is not set
# CONFIG_DNOTIFY is not set
# CONFIG_INOTIFY_USER is not set
CONFIG_VFAT_FS=y
CONFIG_PROC_KCORE=y
CONFIG_TMPFS=y
CONFIG_UBIFS_FS=y
CONFIG_UBIFS_FS_ADVANCED_COMPR=y
# CONFIG_UBIFS_FS_LZO is not set
# CONFIG_UBIFS_FS_ZLIB is not set
CONFIG_SQUASHFS=y
# CONFIG_NETWORK_FILESYSTEMS is not set
CONFIG_NLS_CODEPAGE_437=y
CONFIG_NLS_CODEPAGE_936=y
CONFIG_NLS_ASCII=y
CONFIG_NLS_ISO8859_1=y
# CONFIG_FTRACE is not set
# CONFIG_CRYPTO_HW is not set
```

## arch/mips/jz4740/Kconfig
```kconfig
choice
	prompt "Machine type"
	depends on MACH_INGENIC
	default JZ4740_QI_LB60

config JZ4740_QI_LB60
	bool "Qi Hardware Ben NanoNote"
	select MACH_JZ4740

config JZ4770_GCW0
	bool "GCW Zero handheld game/media player"
	select MACH_JZ4770

endchoice

config JZSOC
	bool

config JZRISC
	bool

config MACH_JZ4740
	bool
	select SYS_HAS_CPU_MIPS32_R1

config MACH_JZ4770
	bool
	select CPU_SUPPORTS_CPUFREQ
	select JZSOC
	select JZRISC
	select MIPS_EXTERNAL_TIMER
	select PINCTRL
	select SYS_HAS_CPU_MIPS32_R2
	select SYS_SUPPORTS_HIGHMEM

config MACH_JZ4780
	bool
	select MIPS_CPU_SCACHE
	select PINCTRL
	select SYS_HAS_CPU_MIPS32_R2
	select SYS_SUPPORTS_HIGHMEM
```

## drivers/gpu/vivante/Kconfig
```kconfig
#
# Vivante GPU support.
#
config GPU_VIVANTE_V4
	tristate "Open Vivante V4 support"
	depends on JZSOC
	help
	  Enable support for Vivante GPU cores. Version 4 interface.
          If built as module, this builds a module named "galcore_v4.ko".

config GPU_VIVANTE_GC860
	def_bool y if MACH_JZ4770
	depends on GPU_VIVANTE_V4
```

## drivers/net/wireless/rtl8192cu/Kconfig
```kconfig
config RTL8192CU
	tristate "Realtek 8192C USB WiFi"
	depends on USB
	select CFG80211_WEXT
	select WIRELESS_EXT
	select WEXT_PRIV
	---help---
	  Help message of RTL8192CU
```

## drivers/pinctrl/ingenic/Kconfig
```kconfig
#
# Ingenic SoCs pin control drivers
#
config PINCTRL_INGENIC
	bool
	select PINMUX
	select GPIOLIB_IRQCHIP
	select GENERIC_PINCONF

config PINCTRL_JZ4740
	bool "Pinctrl driver for the Ingenic JZ4740 SoC"
	default y
	depends on MACH_JZ4740 || COMPILE_TEST
	select PINCTRL_INGENIC

config PINCTRL_JZ4780
	bool "Pinctrl driver for the Ingenic JZ4780 SoC"
	default y
	depends on MACH_JZ4780 || COMPILE_TEST
	select PINCTRL_INGENIC
```

## drivers/video/displays/Kconfig
```kconfig
#
# Displays configuration
#

menu "Display Device Drivers"

# TODO: Switch to tristate once the panel drivers are modules.

config PANEL_IT6610
	bool "ITE Tech IT6610 HDMI connected panel"
	depends on I2C
	help
	  Select this if you are using a panel connected through the ITE Tech
	  IT6610 HDMI transmitter.

config PANEL_NT39016
	bool "Novatek NT39016 based panel"
	help
	  Select this if you are using a Novatek NT39016 LCD driver IC.

endmenu
```

## sound/soc/jz4770/Kconfig
```kconfig
config SND_JZ4770_SOC
	tristate "SoC Audio for Ingenic JZ4770 SoC"
	depends on MACH_JZ4770 && SND_SOC
	help
	  Say Y or M if you want to add support for codecs attached to
	  the JZ4770 I2S interface. You will also need to select the audio
	  interfaces to support below.

config SND_JZ4770_SOC_I2S
	depends on SND_JZ4770_SOC
	tristate "SoC Audio (I2S protocol) for Ingenic JZ4770 SoC"
	help
	  Say Y if you want to use I2S protocol and I2S codec on Ingenic JZ4770
	  based boards.
```
