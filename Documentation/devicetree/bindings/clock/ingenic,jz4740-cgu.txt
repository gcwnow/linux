## Documentation/devicetree/bindings/clock/ingenic,jz4740-cgu.txt
```
Ingenic jz4740 SoC CGU binding

The CGU in a jz4740 SoC provides all the clocks generated on-chip. It includes
PLLs, multiplexers, dividers & gates in order to provide a variety of different
clock signals derived from only 2 external source clocks.

Required properties:
- compatible: Should be "ingenic,jz4740-cgu"
- reg: Should be the address & length of the CGU registers
- clocks: Should contain the phandle & clock specifier for two clocks external
          to the TCU. First the external crystal "ext" and second the RTC
          clock source "rtc".
- clock-names: Should be set to strings naming the clocks specified in the
               "clocks" property.
- #clock-cells: Should be 1.
                Clock consumers specify this argument to identify a clock. The
                valid values may be found in <dt-bindings/clock/jz4740-cgu.h>.

Example SoC include file:

/ {
	cgu: jz4740-cgu {
		compatible = "ingenic,jz4740-cgu";
		reg = <0x10000000 0x100>;
		#clock-cells = <1>;
	};

	uart0: serial@10030000 {
		clocks = <&cgu JZ4740_CLK_UART0>;
	};
};

Example board file:

/ {
	ext: clock@0 {
		compatible = "fixed-clock";
		#clock-cells = <0>;
		clock-frequency = <12000000>;
	};

	rtc: clock@1 {
		compatible = "fixed-clock";
		#clock-cells = <0>;
		clock-frequency = <32768>;
	};

	&cgu {
		clocks = <&ext> <&rtc>;
		clock-names: "ext", "rtc";
	};
};
```

## Documentation/devicetree/bindings/clock/ingenic,jz4780-cgu.txt
```
Ingenic jz4780 SoC CGU binding

The CGU in a jz4780 SoC provides all the clocks generated on-chip. It includes
PLLs, multiplexers, dividers & gates in order to provide a variety of different
clock signals derived from only 2 external source clocks.

Required properties:
- compatible: Should be "ingenic,jz4780-cgu"
- reg: Should be the address & length of the CGU registers
- clocks: Should contain the phandle & clock specifier for two clocks external
          to the TCU. First the external crystal "ext" and second the RTC
          clock source "rtc".
- clock-names: Should be set to strings naming the clocks specified in the
               "clocks" property.
- #clock-cells: Should be 1.
                Clock consumers specify this argument to identify a clock. The
                valid values may be found in <dt-bindings/clock/jz4780-cgu.h>.

Example SoC include file:

/ {
	cgu: jz4780-cgu {
		compatible = "ingenic,jz4780-cgu";
		reg = <0x10000000 0x100>;
		#clock-cells = <1>;
	};

	uart0: serial@10030000 {
		clocks = <&cgu JZ4780_CLK_UART0>;
	};
};

Example board file:

/ {
	ext: clock@0 {
		compatible = "fixed-clock";
		#clock-cells = <0>;
		clock-frequency = <48000000>;
	};

	rtc: clock@1 {
		compatible = "fixed-clock";
		#clock-cells = <0>;
		clock-frequency = <32768>;
	};

	&cgu {
		clocks = <&ext> <&rtc>;
		clock-names: "ext", "rtc";
	};
};
```

## Documentation/devicetree/bindings/clock/ingenic,tcu-clocks.txt
```
Ingenic SoC TCU binding

The TCU is the Timer/Counter Unit present in all Ingenic SoCs. It features 8
channels, each one having its own clock, that can be started and stopped,
reparented, and reclocked.

Required properties:
- compatible : One of:
  * ingenic,jz4740-tcu-clocks,
  * ingenic,jz4770-tcu-clocks,
  * ingenic,jz4780-tcu-clocks.
- clocks : List of phandle & clock specifiers for clocks external to the TCU.
  The "pclk", "rtc" and "ext" clocks should be provided.
- clock-names : List of name strings for the external clocks.
- #clock-cells: Should be 1.
  Clock consumers specify this argument to identify a clock. The valid values
  may be found in <dt-bindings/clock/ingenic,tcu.h>.

Example:

/ {
	regmap {
		compatible = "simple-mfd", "syscon";
		reg = <0x10002000 0x1000>;

		tcu: clocks {
			compatible = "ingenic,jz4740-tcu-clocks";

			clocks = <&ext>, <&rtc>, <&pclk>;
			clock-names = "ext", "rtc", "pclk";

			#clock-cells = <1>;
		};
	};
};
```

## Documentation/devicetree/bindings/interrupt-controller/ingenic,tcu.txt
```
Ingenic SoCs Timer/Counter Unit Interrupt Controller

Required properties:

- compatible : should be "ingenic,<socname>-tcu-intc". Valid strings are:
  * ingenic,jz4740-tcu-intc
  * ingenic,jz4770-tcu-intc
  * ingenic,jz4780-tcu-intc
- interrupt-controller : Identifies the node as an interrupt controller
- #interrupt-cells : Specifies the number of cells needed to encode an
  interrupt source. The value shall be 1.
- interrupt-parent : phandle of the interrupt controller.
- interrupts : Specifies the interrupt the controller is connected to.

Example:

/ {
	regmap {
		compatible = "simple-mfd", "syscon";
		reg = <0x10002000 0x1000>;

		tcu: interrupt-controller {
			compatible = "ingenic,jz4740-tcu-intc";

			interrupt-controller;
			#interrupt-cells = <1>;

			interrupt-parent = <&intc>;
			interrupts = <15>;
		};
	};
};
```

## Documentation/devicetree/bindings/media/i2c/rda5807.txt
```
* RDA Microelectronics RDA5807 FM radio receiver


Required properties:

- compatible: Must be "rdamicro,rda5807"


Optional properties:

- lnan: Use LNAN input port.
- lnap: Use LNAP input port.
  Dual port input is possible.

- lna-current: LNA working current: 1800, 2100, 2500 or 3000 uA.
  Default is 2500 uA (2.5 mA).

- analog-out: Enable analog output.

- i2s-out: Enable I2S output.


Example:

	i2c@0 {
		...
		rda5807@11 {
			compatible = "rdamicro,rda5807";
			reg = <0x11>;
			lnap;
			lna-current = <2500>;
			analog-out;
		};
		...
	};
```

## Documentation/devicetree/bindings/net/rfkill-regulator.txt
```
* rfkill-regulator - Regulator consumer driver for rfkill *

Required properties:
  - compatible:		should be "rfkill-regulator"
  - rfkill-name:	the name of this rfkill device
  - rfkill-type:	the type of this rfkill device.
		Must correspond to a valid rfkill_type from <uapi/linux/rfkill.h>

Example:

	wlan-rfkill {
		compatible = "rfkill-regulator";
		rfkill-name = "WLAN power switch";
		rfkill-type = <1>;
	};
```

## Documentation/devicetree/bindings/pinctrl/ingenic,jz4780-pinctrl.txt
```
Ingenic jz4780 pin controller

Required properties:
- compatible: "ingenic,jz4780-pinctrl"

- reg: Should contain the physical address and length of the GPIO port
  configuration registers (PAPIN..PFDRVHC).

Please refer to pinctrl-bindings.txt in this directory for details of the
common pinctrl bindings used by client devices, including the meaning of the
phrase "pin configuration node".

For the jz4780, pin control is tightly bound with GPIO ports. All pins may
be used as GPIOs, multiplexed device functions are configured within the
GPIO port configuration registers and it is typical to refer to pins using the
naming scheme "PxN" where x is a character identifying the GPIO port with
which the pin is associated and N is an integer from 0 to 31 identifying the
pin within that GPIO port. For example PA0 is the first pin in GPIO port A, and
PB31 is the last pin in GPIO port B. The jz4780 contains 6 GPIO ports, PA to
PF, for a total of 192 pins.

Each subnode of the pin controller node is either a GPIO controller node, a pin
configuration node or a pin function node.

Required GPIO controller node properties:
- gpio-controller: Identifies this node as a GPIO controller.

- #gpio-cells: Should contain the integer 2.

Optional GPIO controller node properties:
- ingenic,pull-ups: A bit mask identifying the pins associated with this GPIO
  port which feature a pull-up resistor.

- ingenic,pull-downs: A bit mask identifying the pins associated with this GPIO
  port which feature a pull-down resistor.

Each pin of the jz4780 may feature a single bias resistor, thus there should be
no bits which are set in both ingenic,pull-ups & ingenic,pull-downs.

Pin configuration nodes use generic pinconf properties to specify an electrical
configuration of a pin. The only configurable property of a jz4780 pin is
whether to enable its bias resistor. Thus the only supported pinconf properties
are:

- bias-disable
- bias-pull-up
- bias-pull-down

No arguments are supported for any of these properties, and any subnode of the
pin controller node which contains any of these properties will be treated as a
pin configuration node. For more information about generic pinconfig properties,
see Documentation/devicetree/bindings/pinctrl/pinctrl-bindings.txt

Every other subnode of the pin controller node (that is, every subnode which
does not contain a gpio-controller or bias-* property) will be treated as a pin
function node. These subnodes represent a functionality of the SoC which may be
exposed through one or more groups of pins, represented as subnodes of the pin
function node. For example a function may be uart0, which may be exposed
through the group of pins PF0 to PF3.

Required pin function node properties:
- None.

Optional pin function node properties:
- None.

Each subnode of a pin function node is a pin group node.

Required pin group node properties:
- ingenic,pins: A set of values representing the pins within this pin group and
  their configuration. Four values should be provided for each pin:

  - The phandle of the GPIO controller node for the GPIO port within which the
    pin is found.

  - The index of the pin within its GPIO port (an integer in the range 0 to 31
    inclusive).

  - The index of the shared function port to be programmed in the GPIO port
    registers. Tables of these may be found in the jz4780 programming manual
    within the "General-Purpose I/O Ports" -> "Overview" section.

  - The phandle of a pin configuration node specifying the electrical
    configuration that should be applied to the pin.

For example the function 'msc0' may be exposed through 2 different pin groups,
one in GPIO port A and one in GPIO port E:

  pincfg_nobias: nobias {
    bias-disable;
  };

  pinfunc_msc0: msc0 {
    pins_msc0_pa: msc0-pa {
      ingenic,pins = <&gpa  4 1 &pincfg_nobias   /* d4 */
                      &gpa  5 1 &pincfg_nobias   /* d5 */
                      &gpa  6 1 &pincfg_nobias   /* d6 */
                      &gpa  7 1 &pincfg_nobias   /* d7 */
                      &gpa 18 1 &pincfg_nobias   /* clk */
                      &gpa 19 1 &pincfg_nobias   /* cmd */
                      &gpa 20 1 &pincfg_nobias   /* d0 */
                      &gpa 21 1 &pincfg_nobias   /* d1 */
                      &gpa 22 1 &pincfg_nobias   /* d2 */
                      &gpa 23 1 &pincfg_nobias   /* d3 */
                      &gpa 24 1 &pincfg_nobias>; /* rst */
    };

    pins_msc0_pe: msc0-pe {
      ingenic,pins = <&gpe 20 0 &pincfg_nobias   /* d0 */
                      &gpe 21 0 &pincfg_nobias   /* d1 */
                      &gpe 22 0 &pincfg_nobias   /* d2 */
                      &gpe 23 0 &pincfg_nobias   /* d3 */
                      &gpe 28 0 &pincfg_nobias   /* clk */
                      &gpe 29 0 &pincfg_nobias>; /* cmd */
    };
  };

For the jz4780 pin controller, a pin configuration node is synonymous with a
pin group node. Thus in the msc0 example above the nodes labeled pins_msc0_pa
and pins_msc0_pe may be used as pin configuration nodes.
```

## Documentation/devicetree/bindings/rtc/ingenic,jz4740-rtc.txt
```
JZ4740 and similar SoCs real-time clock driver

Required properties:

- compatible: One of:
  - "ingenic,jz4740-rtc" - for use with the JZ4740 SoC
  - "ingenic,jz4770-rtc" - for use with the JZ4770 SoC
- reg: Address range of rtc register set
- interrupts: IRQ number for the alarm interrupt
- interrupt-parent: phandle of the interrupt controller

Example:

rtc@10003000 {
	compatible = "ingenic,jz4740-rtc";
	reg = <0x10003000 0x3F>;

	interrupt-parent = <&intc>;
	interrupts = <32>;
};
```

## Documentation/devicetree/bindings/timer/ingenic,tcu.txt
```
Ingenic JZ47xx SoCs Timer/Counter Unit driver
---------------------------------------------

Required properties:

- compatible : should be "ingenic,<socname>-tcu". Valid strings are:
  * ingenic,jz4740-tcu
  * ingenic,jz4770-tcu
  * ingenic,jz4780-tcu
- interrupt-parent : phandle of the TCU interrupt controller.
- interrupts : Specifies the interrupts the controller is connected to.
- clocks : List of phandle & clock specifiers for the TCU clocks.
- clock-names : List of name strings for the TCU clocks.

Example:

/ {
	regmap {
		compatible = "simple-mfd", "syscon";
		reg = <0x10002000 0x1000>;

		tcu: timer {
			compatible = "ingenic,jz4740-tcu";

			clocks = <&tcu 0>, <&tcu 1>, <&tcu 2>, <&tcu 3>,
					 <&tcu 4>, <&tcu 5>, <&tcu 6>, <&tcu 7>;
			clock-names = "timer0", "timer1", "timer2", "timer3",
						  "timer4", "timer5", "timer6", "timer7";

			interrupt-parent = <&tcu>;
			interrupts = <0 1 2 3 4 5 6 7>;
		};
	};
};
```

## Documentation/devicetree/bindings/watchdog/ingenic,jz47xx-wdt.txt
```
Ingenic Watchdog Timer (WDT) Controller for JZ47XX

Required properties:
compatible: "ingenic,jz4780-watchdog" or "ingenic,jz4740-watchdog"
reg: Register address and length for watchdog registers
clocks: phandle to rtcclk
clock-names: must be "rtc"

Examples:

watchdog: jz47xx-watchdog@0x10002000 {
	compatible = "ingenic,jz4780-watchdog";
	reg = <0x10002000 0x100>;

	clocks = <&rtclk>;
	clock-names = "rtc";
};
```
