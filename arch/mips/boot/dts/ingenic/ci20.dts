/dts-v1/;

#include "jz4780.dtsi"

/ {
	compatible = "img,ci20", "ingenic,jz4780";

	chosen {
		stdout-path = &uart4;
	};

	memory {
		device_type = "memory";
		reg = <0x0 0x10000000
		       0x30000000 0x30000000>;
	};
};

&ext {
	clock-frequency = <48000000>;
};
